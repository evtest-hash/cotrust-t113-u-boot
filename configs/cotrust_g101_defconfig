## configs/cotrust_g101_defconfig
```kconfig
CONFIG_ARM=y
CONFIG_ARCH_SUNXI=y
CONFIG_DEFAULT_DEVICE_TREE="sun8i-t113-cotrust-g101"
CONFIG_SPL_TEXT_BASE=0x20060
CONFIG_SPL_STACK_R_ADDR=0x48000000
CONFIG_SPL=y
CONFIG_MACH_SUN8I_T113=y
CONFIG_DRAM_CLK=360
CONFIG_VIDEO_DE2=y
CONFIG_SPL_SPI_SUNXI=y
# CONFIG_ANDROID_BOOT_IMAGE is not set
CONFIG_PREBOOT="fastboot usb 0"
CONFIG_EVENT=y
CONFIG_EVENT_DYNAMIC=y
CONFIG_SPL_STACK=0x38000
# CONFIG_CMD_BOOTFLOW is not set
# CONFIG_BOOTM_NETBSD is not set
# CONFIG_BOOTM_VXWORKS is not set
# CONFIG_CMD_ELF is not set
# CONFIG_CMD_GPT is not set
CONFIG_CMD_MTD=y
CONFIG_CMD_USB_MASS_STORAGE=y
CONFIG_CMD_MTDPARTS=y
CONFIG_MTDIDS_DEFAULT="spi-nand0=spi0.0"
CONFIG_MTDPARTS_DEFAULT="mtdparts=spi0.0:128k(spl_a),768k(bootloader_a),128k(dtb_a),6m(kernel_a),-(filesystem_a)"
CONFIG_CMD_UBI=y
# CONFIG_EFI_PARTITION is not set
CONFIG_ENV_IS_IN_FAT=y
CONFIG_DM_EVENT=y
CONFIG_FASTBOOT_BUF_ADDR=0x41000000
CONFIG_FASTBOOT_BUF_SIZE=0x4000000
CONFIG_SUNXI_GPIO_V2=y
# CONFIG_MMC is not set
CONFIG_MTD=y
CONFIG_DM_MTD=y
CONFIG_MTD_SPI_NAND=y
CONFIG_SPI_FLASH_WINBOND=y
CONFIG_UBI_SILENCE_MSG=y
CONFIG_PHY_SUN4I_USB=y
CONFIG_DM_PWM=y
CONFIG_PWM_SUNXI=y
CONFIG_CONS_INDEX=3
CONFIG_SPI=y
CONFIG_USB_EHCI_HCD=y
CONFIG_USB_OHCI_HCD=y
CONFIG_USB_MUSB_GADGET=y
CONFIG_USB_KEYBOARD_FN_KEYS=y
CONFIG_USB_GADGET_VENDOR_NUM=0x18d1
CONFIG_USB_GADGET_PRODUCT_NUM=0x4d00
# CONFIG_USB_ETHER is not set
# CONFIG_SHA256 is not set
# CONFIG_SPL_SHA1 is not set
# CONFIG_EFI_LOADER is not set
```

## configs/t113_defconfig
```kconfig
CONFIG_ARM=y
CONFIG_ARCH_SUNXI=y
CONFIG_DEFAULT_DEVICE_TREE="sun8i-t113-mangopi-dual"
CONFIG_SPL=y
CONFIG_MACH_SUN8I_T113=y
CONFIG_DRAM_CLK=360

CONFIG_SPI=y
CONFIG_SPI_FLASH_WINBOND=y

CONFIG_USB_MUSB_GADGET=y
CONFIG_USB_MUSB_SUNXI=y
CONFIG_PHY_SUN4I_USB=y
CONFIG_CMD_FASTBOOT=y
CONFIG_FASTBOOT_CMD_OEM_FORMAT=y
CONFIG_CMD_USB_MASS_STORAGE=y

CONFIG_VIDEO_DE2=y

CONFIG_DM_PWM=y
CONFIG_PWM_SUNXI=y

CONFIG_USB_EHCI_HCD=y
CONFIG_USB_EHCI_GENERIC=y
CONFIG_USB_OHCI_HCD=y
CONFIG_USB_OHCI_GENERIC=y

CONFIG_USB_HOST_ETHER=y
CONFIG_USB_ETHER_ASIX88179=y

CONFIG_SPL_TEXT_BASE=0x20060
CONFIG_SPL_STACK=0x38000
CONFIG_SPL_STACK_R_ADDR=0x48000000
CONFIG_SPL_SPI_SUNXI=y
CONFIG_SPL_MMC=y

CONFIG_SUNXI_GPIO_V2=y
```
